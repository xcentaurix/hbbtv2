## meta-hbbtv2/conf/layer.conf
```bitbake
BBPATH .= ":${LAYERDIR}"
BBFILES += "${LAYERDIR}/recipes-*/*/*.bb ${LAYERDIR}/recipes-*/*/*.bbappend"

BBFILE_COLLECTIONS += "hbbtv2"
BBFILE_PATTERN_hbbtv2 := "^${LAYERDIR}/"
BBFILE_PRIORITY_hbbtv2 = "9"

LAYERDEPENDS_hbbtv2 = "core openembedded-layer webkit"
LAYERSERIES_COMPAT_hbbtv2 = "wrynose"
```
